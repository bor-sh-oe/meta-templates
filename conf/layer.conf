## conf/layer.conf
```bitbake
# We have a conf and classes directory, append to BBPATH
BBPATH .= ":${LAYERDIR}"

# We have a recipes directory, add to BBFILES
BBFILES += "${LAYERDIR}/recipes-*/*/*.bb ${LAYERDIR}/recipes-*/*/*.bbappend"

BBFILE_COLLECTIONS += "ros-extra-layer"
BBFILE_PATTERN_ros-extra-layer := "^${LAYERDIR}/"
BBFILE_PRIORITY_ros-extra-layer = "7"

LICENSE_PATH += "${LAYERDIR}/licenses"
```

## conf/machine/imx35pdkfslc.conf
```bitbake
#@TYPE: Machine
#@NAME: Freescale i.MX35 Platform Development Kit
#@SOC: i.MX35
#@DESCRIPTION: Machine configuration for Freescale i.MX35 Platform Development Kit
# Actually not required since linux-fslc is configured for mx3 to be the prefereed provider

include conf/machine/imx35pdk.conf

PREFERRED_PROVIDER_virtual/kernel = "linux-fslc"
```
